#include "FS.h"
#include "SD.h"
#include "SPI.h"

// Libraries to get time from NTP Server
#include <WiFi.h>
#include <NTPClient.h>
#include <WiFiUdp.h>

#include <Wire.h>
#include <Adafruit_GFX.h>
#include <Adafruit_SSD1306.h>

// Define e Configura Display
#define SCREEN_WIDTH 128
#define SCREEN_HEIGHT 64
#define OLED_RESET 4
#define SCREEN_ADDRESS 0x3C
Adafruit_SSD1306 display(SCREEN_WIDTH, SCREEN_HEIGHT, &Wire, OLED_RESET);

#define SIZE 128*64/8

// Define deep sleep options
uint64_t uS_TO_S_FACTOR = 1000000;  // Conversion factor for micro seconds to seconds
// Sleep for 10 minutes = 600 seconds
uint64_t TIME_TO_SLEEP = 600;

// // Replace with your network credentials
// char* ssid;
// char* password;

// Define NTP Client to get time
WiFiUDP ntpUDP;
NTPClient timeClient(ntpUDP);

// Definição de Pinos
const int pinAddA = 13;
const int pinAddB = 12;
const int pinAddC = 14;

const unsigned char  PROGMEM playbtn[] = {
	0xff, 0xff, 0xff, 0xff, 0xff, 0xff, 0xff, 0xc0, 0x03, 0xff, 0xff, 0xff, 0xff, 0xff, 0xff, 0xff, 
	0xff, 0xff, 0xff, 0xff, 0xff, 0xff, 0xfc, 0x00, 0x00, 0x3f, 0xff, 0xff, 0xff, 0xff, 0xff, 0xff, 
	0xff, 0xff, 0xff, 0xff, 0xff, 0xff, 0xf0, 0x00, 0x00, 0x0f, 0xff, 0xff, 0xff, 0xff, 0xff, 0xff, 
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	0xff, 0xff, 0xff, 0xff, 0xff, 0xff, 0xff, 0xc0, 0x03, 0xff, 0xff, 0xff, 0xff, 0xff, 0xff, 0xff
};


const unsigned char PROGMEM  volume[] = {
	0xff, 0xff, 0xff, 0xff, 0xff, 0xff, 0xff, 0xff, 0xff, 0xff, 0xff, 0xff, 0xff, 0xff, 0xff, 0xff, 
	0xff, 0xff, 0xff, 0xff, 0xff, 0xff, 0xff, 0xff, 0xff, 0xff, 0xff, 0xff, 0xff, 0xff, 0xff, 0xff, 
	0xff, 0xff, 0xff, 0xff, 0xff, 0xff, 0xff, 0xff, 0xff, 0xff, 0xff, 0xff, 0xff, 0xff, 0xff, 0xff, 
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	0xff, 0xff, 0xff, 0xff, 0xff, 0xff, 0xff, 0xff, 0xff, 0xff, 0xff, 0xff, 0xff, 0xff, 0xff, 0xff
};

long convertDecimalToBinary(int number) {
  int reminder;
  String bin;
  while (number) {
    reminder = number % 2;
    number = number / 2;
    bin = String(reminder) + bin;
  }
  return bin.toInt();
}


void selDisp(int dispid) {
    // Serial.println(convertDecimalToBinary(dispid));
    digitalWrite(pinAddA, HIGH );
    digitalWrite(pinAddB, HIGH );
    digitalWrite(pinAddC, HIGH );
    digitalWrite(pinAddA, (dispid & 4 ? HIGH : LOW));
    digitalWrite(pinAddB, (dispid & 2 ? HIGH : LOW));
    digitalWrite(pinAddC, (dispid & 1 ? HIGH : LOW));
    // Serial.print("SELDISP ID:");
    // Serial.println(dispid);
    // Serial.println((dispid & 4 ? HIGH : LOW));
    // Serial.println((dispid & 2 ? HIGH : LOW));
    // Serial.println((dispid & 1 ? HIGH : LOW));
}

void clearDisp(int dispid) {
  selDisp(dispid);
  delay(100); // Pause for 100ms
  display.clearDisplay();
}

void initDisp(int dispid) {
  selDisp(dispid);
  delay(100); // Pause for 100ms
  display.begin(SSD1306_SWITCHCAPVCC, SCREEN_ADDRESS);
  display.clearDisplay();
  display.setTextColor(WHITE);
  display.setTextSize(2);
  display.setCursor(0, 0);
  display.print(dispid);
  display.display();
}

void txtDisp(int dispid, int linenum, String line, int clear) {
  selDisp(dispid);
  delay(200); // Pause for 200ms
  if ( clear == 1) {
    clearDisp(dispid);
  }
  display.setTextColor(WHITE);
  display.setTextSize(2);
  display.setCursor(0, 15*linenum);
  display.print(line);
  display.display();
}

void listDir(fs::FS &fs, const char * dirname, uint8_t levels){

  File root = fs.open(dirname);
  if(!root){
    Serial.println("Failed to open directory");
    return;
  }
  if(!root.isDirectory()){
    Serial.println("Not a directory");
    return;
  }

  File file = root.openNextFile();
  while(file){
    if(file.isDirectory()){
      Serial.print("  DIR : ");
      Serial.println(file.name());
      if(levels){
        listDir(fs, file.name(), levels -1);
      }
    } else {
      Serial.print("  FILE: ");
      Serial.print(file.name());
      Serial.print("  SIZE: ");
      Serial.println(file.size());
    }
    file = root.openNextFile();
  }
}

void writeFile(fs::FS &fs, const char * path, const char * message){
  Serial.printf("Writing file: %s\n", path);

  File file = fs.open(path, FILE_WRITE);
  if(!file){
    Serial.println("Failed to open file for writing");
    return;
  }
  if(file.print(message)){
    Serial.println("File written");
  } else {
    Serial.println("Write failed");
  }
  file.close();
}

void appendFile(fs::FS &fs, const char * path, const char * message){
  Serial.printf("Appending to file: %s\n", path);

  File file = fs.open(path, FILE_APPEND);
  if(!file){
    Serial.println("Failed to open file for appending");
    return;
  }
  if(file.print(message)){
      Serial.println("Message appended");
  } else {
    Serial.println("Append failed");
  }
  file.close();
}

//read wifi.txt from the sd card root
//expected file contents: 
//SSID      (line1)
//PASSWORD  (line2)
String readWifi(fs::FS &fs, const char * path, int line){

  File file = fs.open(path);

  Serial.print("Read from Wifi.txt: ");
  String received;  
  String received2;  
  char ch;
  int linecount=0;
  while (file.available()) {
    ch = file.read();
    if (ch == '\n') {

      linecount++;
      received2 = received;
      received = "";
    } else {
      received += ch;
    }
    if (linecount == line) {
      return received2;
    }


  }
  return received2;  
}

// get date and format from ntpserver
String getDate(int dateformat){
  String months[12]={"January", "February", "March", "April", "May", "June", "July", "August", "September", "October", "November", "December"};
  unsigned long epochTime = timeClient.getEpochTime();
  //Get a time structure
  struct tm *ptm = gmtime ((time_t *)&epochTime); 
  int monthDay = ptm->tm_mday;
  int currentMonth = ptm->tm_mon+1;
  String currentMonthName = months[currentMonth-1];
  int currentYear = ptm->tm_year+1900;
  String currentDate = "N/A";

  //Print complete date:
  if (dateformat == 0) {
     currentDate = String(monthDay) + "-" + String(currentMonth) + "-" + String(currentYear);
  } else if (dateformat == 1)
  {
     currentDate = String(monthDay) + "-" + String(currentMonth);
  } else if (dateformat == 2)
  {
     currentDate = String(monthDay) + "-" + String(currentMonth);
  } else if (dateformat == 3) {
     currentDate = String(monthDay) + "-" + String(currentMonth) + "-" + String(currentYear) + " - "+ timeClient.getFormattedTime();
  }
  return currentDate;
}


uint8_t StrToHex(String str)
{
  return (int) strtol(str.c_str() , 0, 16);
}

void readsdanddisplay(int dispid,  String filename) {
  File f = SD.open(filename);
  Serial.println(filename);
  uint8_t oled_buf;
  int row = 0;
  int col = 0;
  clearDisp(dispid);
  selDisp(dispid);
  while (f.available()) {
    String item = f.readStringUntil(',');      
    oled_buf = StrToHex(item);          
    for (uint8_t cnt = 8; cnt >0; cnt--) {
        display.drawPixel(col+cnt-1, row, (oled_buf & 0x01) ? WHITE : BLACK);
        oled_buf >>= 1;
    }
    col = col+8;
    if (col == 128) { 
      col=0;
      row++;
    }
  }
  display.display();
  f.close();
}




//***********
// SETUP
//***********
void setup(){
  Serial.begin(115200);
  Wire.begin();

  pinMode(pinAddA, OUTPUT);
  pinMode(pinAddB, OUTPUT);
  pinMode(pinAddC, OUTPUT);  

  digitalWrite(pinAddA, LOW);
  digitalWrite(pinAddB, LOW);
  digitalWrite(pinAddC, LOW);

  // Inicializa Displays no endereço 0x3C do I2C
  initDisp(0);

  initDisp(1);

  initDisp(2);

  initDisp(3);

  initDisp(4);

  initDisp(5);


  if(!SD.begin(5)){
    Serial.println("Card Mount Failed");
    txtDisp(0, 0, "SD Fail",0);
    return;
  }
  uint8_t cardType = SD.cardType();

  if(cardType == CARD_NONE){
    Serial.println("No SD card attached");
    txtDisp(0, 0, "SD Fail",0);
    return;
  }

  uint64_t cardSize = SD.cardSize() / (1024 * 1024);
  Serial.printf("SD Card Size: %lluMB\n", cardSize);
  txtDisp(0, 0, "SD OK",1);
  txtDisp(0, 1, "Size: "+ String(int(cardSize)),0);

  readsdanddisplay(3,"/fig3.img");
  readsdanddisplay(4,"/fig2.img");
  readsdanddisplay(5,"/fig4.img");

  String ssid = readWifi(SD, "/wifi.txt",1);
  String pass = readWifi(SD, "/wifi.txt",2);
  delay(300);
  txtDisp(1, 0, "WIFI...",1);
  txtDisp(1, 1, ssid,0);
  WiFi.begin(ssid.c_str(), pass.c_str());


  while (WiFi.status() != WL_CONNECTED) {
    delay(500);
    Serial.print(".");
  }
  txtDisp(1, 0, "WIFI OK",1);
  txtDisp(1, 2, WiFi.localIP().toString().c_str(),0);

  txtDisp(2, 0, "NTP...",1);
  // Initialize a NTPClient to get time
  timeClient.begin();
  // Set offset time in seconds to adjust for your timezone, for example:
  // GMT +1 = 3600
  // GMT +8 = 28800
  // GMT -1 = -3600
  // GMT 0 = 0

  timeClient.setTimeOffset(-10800);

  timeClient.update();
  txtDisp(2, 0, "NTP OK",1);
  txtDisp(2, 1, getDate(3),0);


  Serial.println("");
  Serial.println(getDate(3) + "> WiFi connected.");
  Serial.println(getDate(3) + "> IP address: " + WiFi.localIP().toString().c_str());

  
  delay(2000); // Pause for 2 secondss

  Serial.println (getDate(3) + "> SETUP COMPLETE ");
  readsdanddisplay(0,"/fig3.img");
  readsdanddisplay(1,"/fig2.img");
  readsdanddisplay(2,"/fig4.img");

}



void loop(){

}